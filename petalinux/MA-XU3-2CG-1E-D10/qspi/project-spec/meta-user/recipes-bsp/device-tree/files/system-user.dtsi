/include/ "system-conf.dtsi"
/ {
	model = "Enclustra MA-XU3-2CG-1E-D10 SOM";
};
#include "zynqmp_enclustra_common.dtsi"
#include "zynqmp_enclustra_mars_xu3.dtsi"
#include "zynqmp_enclustra_mars_st3.dtsi"
